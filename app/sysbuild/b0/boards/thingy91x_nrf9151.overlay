/*
 * Copyright (c) 2026 Nordic Semiconductor ASA
 *
 * SPDX-License-Identifier: LicenseRef-Nordic-5-Clause
 */

#include "../../../boards/thingy91x_nrf9151_partitions.dtsi"

&sram0_s {
	reg = <0x0 0x40000>;
};

/ {
	chosen {
		zephyr,code-partition = &b0_partition;
	};
};
