## app/Kconfig
```kconfig
#
# Copyright (c) 2023 Nordic Semiconductor ASA
#
# SPDX-License-Identifier: LicenseRef-Nordic-5-Clause
#

menu "Thingy Out-of-Box Application"

config APP_PAYLOAD_CHANNEL_STRING_MAX_SIZE
	int "Payload maximum string size"
	default 100
	help
	  Maximum size of the string included messages that are sent over the payload channel.

rsource "src/modules/trigger/Kconfig.trigger"
rsource "src/modules/battery/Kconfig.battery"
rsource "src/modules/network/Kconfig.network"
rsource "src/modules/transport/Kconfig.transport"
rsource "src/modules/location/Kconfig.location"
rsource "src/modules/led/Kconfig.led"
rsource "src/modules/app/Kconfig.app"
rsource "src/modules/fota/Kconfig.fota"
rsource "src/modules/environmental/Kconfig.environmental"
rsource "src/modules/memfault/Kconfig.memfault"
rsource "src/modules/shell/Kconfig.shell"

endmenu

menu "Zephyr Kernel"
source "Kconfig.zephyr"
endmenu
```

## app/boards/nrf9161dk_nrf9161_ns.conf
```kconfig
# Enable external flash
CONFIG_SPI=y
CONFIG_SPI_NOR=y
CONFIG_SPI_NOR_SFDP_DEVICETREE=y
CONFIG_PM_OVERRIDE_EXTERNAL_DRIVER_CHECK=y
```

## app/boards/thingy91x_nrf9151_ns.conf
```kconfig
#
# Copyright (c) 2024 Nordic Semiconductor ASA
#
# SPDX-License-Identifier: LicenseRef-Nordic-5-Clause
#

CONFIG_BME680=n
CONFIG_BME68X_IAQ=y
CONFIG_BME68X_IAQ_SAMPLE_RATE_ULTRA_LOW_POWER=y

# Fuel Gage
CONFIG_NRF_FUEL_GAUGE=y
CONFIG_NPM1300_CHARGER=y
```

## app/sample.yaml
```yaml
sample:
  name: app
tests:
  app.build:
    build_only: true
    sysbuild: true
    integration_platforms:
      - thingy91x/nrf9151/ns
    platform_allow:
      - thingy91x/nrf9151/ns
    tags: ci_build
  app.build.bootloader_update:
    build_only: true
    sysbuild: true
    integration_platforms:
      - thingy91x/nrf9151/ns
    platform_allow:
      - thingy91x/nrf9151/ns
    tags: ci_build
    extra_args:
      - mcuboot_CONFIG_FW_INFO_FIRMWARE_VERSION=2
      - CONFIG_BUILD_S1_VARIANT=y
```

## app/src/modules/bluetooth/Kconfig.bluetooth
```kconfig
#
# Copyright (c) 2023 Nordic Semiconductor
#
# SPDX-License-Identifier: LicenseRef-Nordic-5-Clause
#

menu "Bluetooth"
	depends on NRF_CLOUD_COAP

config APP_BLUETOOTH_THREAD_STACK_SIZE
	int "Thread stack size"
	default 1536

config APP_BLUETOOTH_MESSAGE_QUEUE_SIZE
	int "Message queue size"
	default 5
	help
	  ZBus subscriber message queue size.

config APP_BLUETOOTH_WATCHDOG_TIMEOUT_SECONDS
	int "Watchdog timeout seconds"
	default 180

config APP_BLUETOOTH_EXEC_TIME_SECONDS_MAX
	int "Maximum execution time seconds"
	default 120
	help
	  Maximum time allowed for a single execution of the module's thread loop.

module = APP_BLUETOOTH
module-str = Bluetooth
source "subsys/logging/Kconfig.template.log_config"

endmenu # Bluetooth
```

## app/src/modules/environmental/Kconfig.environmental
```kconfig
#
# Copyright (c) 2024 Nordic Semiconductor
#
# SPDX-License-Identifier: LicenseRef-Nordic-5-Clause
#

menuconfig APP_ENVIRONMENTAL
	bool "Environmental module"
	depends on BME68X_IAQ
	default y

if APP_ENVIRONMENTAL

config APP_ENVIRONMENTAL_THREAD_STACK_SIZE
	int "Thread stack size"
	default 1024

config APP_ENVIRONMENTAL_MESSAGE_QUEUE_SIZE
	int "Message queue size"
	default 5
	help
	  ZBus subscriber message queue size.

module = APP_ENVIRONMENTAL
module-str = ENVIRONMENTAL
source "subsys/logging/Kconfig.template.log_config"

endif # APP_ENVIRONMENTAL
```

## app/src/modules/fota/Kconfig.fota
```kconfig
#
# Copyright (c) 2024 Nordic Semiconductor
#
# SPDX-License-Identifier: LicenseRef-Nordic-5-Clause
#

menuconfig APP_FOTA
	bool "FOTA"
	select FOTA
	default y if !BOARD_NATIVE_POSIX

config APP_FOTA_THREAD_STACK_SIZE
	int "Thread stack size"
	default 2048

config APP_FOTA_MESSAGE_QUEUE_SIZE
	int "Message queue size"
	default 5
	help
	  ZBus subscriber message queue size.

config APP_FOTA_WATCHDOG_TIMEOUT_SECONDS
	int "Watchdog timeout seconds"
	default 600

config APP_FOTA_EXEC_TIME_SECONDS_MAX
	int "Maximum execution time seconds"
	default 480
	help
	  Watchdog timeout in seconds for a state machine run.
	  The FOTA module may perform downloads of large files,
	  and the watchdog timeout should be set to a value that is longer than the expected
	  maximum download time in normal operation.

config APP_FOTA_REBOOT_DELAY_SECONDS
	int "Reboot delay seconds"
	default 10
	help
	  Delay in seconds before rebooting after a FOTA_STATUS_REBOOT_PENDING event has been
	  sent.

if APP_FOTA

module = APP_FOTA
module-str = FOTA
source "subsys/logging/Kconfig.template.log_config"

endif # APP_FOTA
```

## app/src/modules/location/Kconfig.location
```kconfig
# Copyright (c) 2024 Nordic Semiconductor
#
# SPDX-License-Identifier: LicenseRef-Nordic-5-Clause
#

menu "Location"
	depends on LOCATION
	depends on LOCATION_DATA_DETAILS

config APP_LOCATION_THREAD_STACK_SIZE
	int "Thread stack size"
	default 4096

module = APP_LOCATION
module-str = Location
source "subsys/logging/Kconfig.template.log_config"

endmenu # Network
```

## app/src/modules/memfault/Kconfig.memfault
```kconfig
#
# Copyright (c) 2024 Nordic Semiconductor
#
# SPDX-License-Identifier: LicenseRef-Nordic-5-Clause
#

menuconfig APP_MEMFAULT
	bool "Memfault"
	select MEMFAULT
	select MEMFAULT_HTTP_PERIODIC_UPLOAD
	select MODEM_KEY_MGMT
	select MEMFAULT_LOGGING_ENABLE
	select MEMFAULT_HTTP_ENABLE
	select MEMFAULT_NCS_LTE_METRICS
	select MEMFAULT_NCS_STACK_METRICS
	select MEMFAULT_NCS_INTERNAL_FLASH_BACKED_COREDUMP

if APP_MEMFAULT

config APP_MEMFAULT_THREAD_STACK_SIZE
	int "Thread stack size"
	default 2048

config APP_MEMFAULT_WATCHDOG_TIMEOUT_SECONDS
	int "Watchdog timeout seconds"
	default 1200

config APP_MEMFAULT_ZBUS_TIMEOUT_SECONDS
	int "Wait for zbus timeout seconds"
	default 60

module = APP_MEMFAULT
module-str = Memfault
source "subsys/logging/Kconfig.template.log_config"

endif # APP_MEMFAULT
```

## drivers/pwm/Kconfig
```kconfig
# Copyright (c) 2023 Nordic Semiconductor ASA
# SPDX-License-Identifier: Apache-2.0

if PWM

rsource "Kconfig.logger"

endif # PWM
```

## drivers/pwm/Kconfig.logger
```kconfig
# Copyright (c) 2023 Nordic Semiconductor ASA
# SPDX-License-Identifier: Apache-2.0

config PWM_LOGGER
	bool "Nordic PWM logger"
	default y
	depends on DT_HAS_NORDIC_PWM_LOGGER_ENABLED
```

## dts/bindings/test/nordic,pwm-logger.yaml
```yaml
# Copyright (c) 2023, Nordic Semiconductor ASA
# SPDX-License-Identifier: Apache-2.0

description: Nordic PWM Logger

compatible: "nordic,pwm-logger"

include: [pwm-controller.yaml, base.yaml]

properties:
  reg:
    required: true

  "#pwm-cells":
    const: 3

pwm-cells:
  - channel
  - period
  - flags
```

## firmware/src/modules/led/Kconfig.led
```kconfig
#
# Copyright (c) 2023 Nordic Semiconductor
#
# SPDX-License-Identifier: LicenseRef-Nordic-5-Clause
#

menuconfig APP_LED
	bool "LED"
	select LED
	default y if !BOARD_NATIVE_POSIX

if APP_LED

module = APP_LED
module-str = LED
source "subsys/logging/Kconfig.template.log_config"

endif # APP_LED
```

## firmware/src/modules/transport/Kconfig.transport
```kconfig
#
# Copyright (c) 2023 Nordic Semiconductor
#
# SPDX-License-Identifier: LicenseRef-Nordic-5-Clause
#

menu "Transport"
	depends on NRF_CLOUD_COAP
	depends on SIMPLE_CONFIG

config APP_TRANSPORT_RECONNECTION_TIMEOUT_SECONDS
	int "Reconnection timeout in seconds"
	default 60
	help
	  Time in between reconnection attempts to the MQTT broker.

config APP_TRANSPORT_THREAD_STACK_SIZE
	int "Thread stack size"
	default 2048

config APP_TRANSPORT_MESSAGE_QUEUE_SIZE
	int "Message queue size"
	default 5
	help
	  ZBus subscriber message queue size.

config APP_TRANSPORT_WORKQUEUE_STACK_SIZE
	int "Workqueue stack size"
	default 4096
	help
	  Stack size of the module's internal workqueue.

config APP_TRANSPORT_POLL_INTERVAL_SECONDS
	int "Poll interval in seconds"
	default 10
	help
	  Interval in seconds between polling nRF Cloud CoAP.

module = APP_TRANSPORT
module-str = Transport
source "subsys/logging/Kconfig.template.log_config"

endmenu # Transport
```

## firstlook/Kconfig
```kconfig
#
# Copyright (c) 2023 Nordic Semiconductor ASA
#
# SPDX-License-Identifier: LicenseRef-Nordic-5-Clause
#

menu "FirstLook application"

rsource "src/modules/led/Kconfig"
rsource "src/modules/gas_sensor/Kconfig"
rsource "src/modules/location/Kconfig"
rsource "src/modules/movement/Kconfig"
rsource "src/modules/sampler/Kconfig.sampler"
rsource "src/modules/network/Kconfig.network"
rsource "src/modules/transport/Kconfig.transport"
rsource "src/modules/trigger/Kconfig.trigger"
rsource "src/modules/error/Kconfig.error"

endmenu

menu "Zephyr Kernel"
source "Kconfig.zephyr"
endmenu
```

## firstlook/src/modules/gas_sensor/Kconfig
```kconfig
#
# Copyright (c) 2023 Nordic Semiconductor
#
# SPDX-License-Identifier: LicenseRef-Nordic-5-Clause
#

module = APP_MODULE_GAS_SENSOR
module-str = GAS_SENSOR
source "subsys/logging/Kconfig.template.log_config"
```

## firstlook/src/modules/led/Kconfig
```kconfig
#
# Copyright (c) 2023 Nordic Semiconductor
#
# SPDX-License-Identifier: LicenseRef-Nordic-5-Clause
#

module = APP_MODULE_LED
module-str = LED
source "subsys/logging/Kconfig.template.log_config"
```

## firstlook/src/modules/location/Kconfig
```kconfig
#
# Copyright (c) 2023 Nordic Semiconductor
#
# SPDX-License-Identifier: LicenseRef-Nordic-5-Clause
#

module = APP_MODULE_LOCATION
module-str = LOCATION
source "subsys/logging/Kconfig.template.log_config"
```

## firstlook/src/modules/movement/Kconfig
```kconfig
#
# Copyright (c) 2023 Nordic Semiconductor
#
# SPDX-License-Identifier: LicenseRef-Nordic-5-Clause
#

module = APP_MODULE_MOVEMENT
module-str = MOVEMENT
source "subsys/logging/Kconfig.template.log_config"
```

## firstlook/src/modules/sampler/Kconfig.sampler
```kconfig
#
# Copyright (c) 2023 Nordic Semiconductor
#
# SPDX-License-Identifier: LicenseRef-Nordic-5-Clause
#

menu "Sampler"

module = APP_MODULE_SAMPLER
module-str = Sampler
source "subsys/logging/Kconfig.template.log_config"

endmenu # Sampler
```

## firstlook/tests/led_module/testcase.yaml
```yaml
tests:
  firstlook.led_module:
    platform_allow: native_posix
    integration_platforms:
      - native_posix
    tags: led_module
```

## lib/Kconfig
```kconfig
# SPDX-License-Identifier: Apache-2.0

menu "Project Libraries"

rsource "hex_coding/Kconfig"

endmenu
```

## lib/hex_coding/Kconfig
```kconfig
# SPDX-License-Identifier: Apache-2.0

config HEX_CODING
        bool "support encoding and decoding in hex format"
```

## lib/simple_config/Kconfig
```kconfig
# Copyright (c) 2024 Nordic Semiconductor
#
# SPDX-License-Identifier: LicenseRef-Nordic-5-Clause
#

menuconfig SIMPLE_CONFIG
	bool "Simple Config library"
	select NRF_CLOUD_COAP

if SIMPLE_CONFIG

module=SIMPLE_CONFIG
module-dep=LOG
module-str=Log level for Simple Config lib
module-help=Enables Simple Config log messages.
source "${ZEPHYR_BASE}/subsys/logging/Kconfig.template.log_config"

endif # SIMPLE_CONFIG
```
