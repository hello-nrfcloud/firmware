## app/Kconfig.sysbuild
```kconfig
#
# Copyright (c) 2025 Nordic Semiconductor ASA
#
# SPDX-License-Identifier: LicenseRef-Nordic-5-Clause
#

config MCUBOOT_USE_ALL_AVAILABLE_RAM
    default y

config PARTITION_MANAGER
	default n

source "${ZEPHYR_BASE}/share/sysbuild/Kconfig"
```

## app/src/modules/battery/Kconfig.battery
```kconfig
#
# Copyright (c) 2023 Nordic Semiconductor
#
# SPDX-License-Identifier: LicenseRef-Nordic-5-Clause
#

menu "Sampler"

config APP_BATTERY_THREAD_STACK_SIZE
	int "Thread stack size"
	default 2048 if MEMFAULT_NRF_PLATFORM_BATTERY_NPM13XX
	default 1536

config APP_BATTERY_WATCHDOG_TIMEOUT_SECONDS
	int "Watchdog timeout seconds"
	default 120

config APP_BATTERY_EXEC_TIME_SECONDS_MAX
	int "Maximum execution time seconds"
	default 3
	help
	  Maximum time allowed for a single execution of the module thread loop.

config APP_BATTERY_SAMPLE_INTERVAL_MS
	int "Fuel gauge sample interval"
	default 1000
	help
	  Interval in milliseconds for periodic fuel gauge sampling while the device is active.

config APP_BATTERY_IDLE_CURRENT_NA
	int "Idle current in nanoamperes"
	help
	  Board idle current in nanoamperes used by the fuel gauge idle estimation when the
	  modem is in sleep. This is a board property and must be set per board.

module = APP_BATTERY
module-str = Battery
source "subsys/logging/Kconfig.template.log_config"

endmenu # Sampler
```
