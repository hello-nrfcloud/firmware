## tests/lib/simple_config/testcase.yaml
```yaml
tests:
  net.lib.simple_config:
    platform_allow: native_sim
    integration_platforms:
      - native_sim
```

## tests/module/environmental/testcase.yaml
```yaml
tests:
  hello_nrfcloud.fw.environmental:
    platform_allow: native_sim
    integration_platforms:
      - native_sim
```

## tests/module/transport/testcase.yaml
```yaml
tests:
  hello_nrfcloud.fw.transport:
    platform_allow: native_sim
    integration_platforms:
      - native_sim
```

## west.yml
```yaml
# Copyright (c) 2021 Nordic Semiconductor ASA
# SPDX-License-Identifier: Apache-2.0

manifest:
  self:
    west-commands: scripts/west-commands.yml
    path: project

  remotes:
    - name: ncs
      url-base: https://github.com/nrfconnect

  projects:
    - name: nrf
      remote: ncs
      repo-path: sdk-nrf
      revision: bc28eb1bade92e5fc37e2faa8d2df14ea403a9c0
      import: true
```
